## zmk-mouse-gesture-multi/Kconfig
```kconfig
# Copyright (c) 2024 The ZMK Contributors
# SPDX-License-Identifier: MIT

config ZMK_MOUSE_GESTURE
    bool "Enable mouse gesture support for ZMK"
    default y
    help
      Allows converting sequences of mouse movements into key presses.
      Supports multiple independent gesture processor instances, each
      activated by a different key (via &mouse_gesture_kp INSTANCE_ID KEY).

config ZMK_MOUSE_GESTURE_EXEC_MAX_EVENTS
    int "Max gesture execution events in queue"
    default 8
    range 1 32
    help
      Size of the message queue for gesture execution events.
      Increase if you see warnings about the queue being full.

config ZMK_MOUSE_GESTURE_REL_QUEUE_LEN
    int "Size of the mouse relative movement event queue"
    default 32
    range 8 128
    help
      Size of the message queue buffering raw relative mouse movements
      before they are processed into gesture sequences.
```

## zmk-mouse-gesture-multi/dts/bindings/behaviors/zmk,behavior-mouse-gesture.yaml
```yaml
# Copyright (c) 2024 The ZMK Contributors
# SPDX-License-Identifier: MIT

description: Mouse Gesture behavior

compatible: "zmk,behavior-mouse-gesture"

properties:
  "#binding-cells":
    type: int
    const: 1
    description: |
      The parameter is the instance_id of the target zip_mouse_gesture processor.
      Used as: &mouse_gesture_kp INSTANCE_ID KEY

  toggle-mode:
    type: string
    default: "flip"
    enum:
      - "on"
      - "off"
      - "flip"
      - "momentary"
    description: |
      Sets the toggle mode for the gesture behavior:
      - "on": Always enable gesture mode
      - "off": Always disable gesture mode
      - "flip": Toggle current state (default)
      - "momentary": Enable while pressed, disable on release
```

## zmk-mouse-gesture-multi/dts/bindings/input-processors/zmk,input-processor-mouse-gesture.yaml
```yaml
# Copyright (c) 2024 The ZMK Contributors
# SPDX-License-Identifier: MIT

description: Mouse Gesture Input Processor

compatible: "zmk,input-processor-mouse-gesture"

properties:
  "#input-processor-cells":
    type: int
    const: 0
    description: "Number of cells in input processor specifier"

  instance-id:
    type: int
    default: 0
    description: |
      Unique ID for this gesture processor instance.
      Must match the first parameter of &mouse_gesture_kp used to activate it.
      E.g. instance-id = <0> is activated by &mouse_gesture_kp 0 KEY,
           instance-id = <1> is activated by &mouse_gesture_kp 1 KEY.

  track-remainders:
    type: boolean
    description: "Whether to track remainders"

  stroke-size:
    type: int
    default: 200
    description: "Size of one stroke in a gesture."

  movement-threshold:
    type: int
    default: 10
    description: "Threshold for each x/y event"

  enable-eager-mode:
    type: boolean
    description: "Execute pattern matching in real-time and invoke bindings immediately when gesture pattern is matched."

  idle-timeout-ms:
    type: int
    default: 150
    description: "Time in milliseconds to wait for idle before invoking gesture. When set to 0, idle timeout is disabled."

  gesture-cooldown-ms:
    type: int
    default: 500
    description: "Time in milliseconds to stop processing for next gesture after the execution of a gesture."

child-binding:
  description: "Mouse gesture definition"
  properties:
    pattern:
      type: array
      required: true
      description: "Array of gesture directions that make up this gesture sequence"

    bindings:
      type: phandle-array
      required: true
      description: "Behaviors to be invoked when this gesture is detected"

    wait-ms:
      type: int
      description: "Time in milliseconds to wait between consecutive behavior invocations"

    tap-ms:
      type: int
      description: "Time in milliseconds between press and release events for each behavior"
```
